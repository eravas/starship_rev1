## boards/shields/starship_r1/Kconfig.defconfig
```kconfig
if SHIELD_STARSHIP_R1_LEFT

config STARSHIP_R1
  default "Starship Rev.1"

config ZMK_SPLIT_ROLE_CENTRAL
  default y

endif

if SHIELD_STARSHIP_R1_LEFT || SHIELD_STARSHIP_R1_RIGHT

config ZMK_SPLIT
  default y

endif
```

## boards/shields/starship_r1/Kconfig.shield
```kconfig
config SHIELD_STARSHIP_R1_LEFT
  def_bool $(shields_list_contains,starship_r1_left)

config SHIELD_STARSHIP_R1_RIGHT
  def_bool $(shields_list_contains,starship_r1_right)
```

## zmk_config/boards/shields/starship_r1/Kconfig.defconfig
```kconfig
if SHIELD_STARSHIP_R1_LEFT

config ZMK_KEYBOARD_NAME
  default "Starship Rev.1"

config ZMK_SPLIT_ROLE_CENTRAL
  default y

endif

if SHIELD_STARSHIP_R1_LEFT || SHIELD_STARSHIP_R1_RIGHT

config ZMK_SPLIT
  default y

endif
```
