#include "starship_r1.dtsi"

&kscan0 {
  row-gpios
    = <&gpio0 09 (GPIO_ACTIVE_HIGH | GPIO_PULL_DOWN)>
    , <&gpio0 10 (GPIO_ACTIVE_HIGH | GPIO_PULL_DOWN)>
    , <&gpio1 11 (GPIO_ACTIVE_HIGH | GPIO_PULL_DOWN)>
    , <&gpio1 13 (GPIO_ACTIVE_HIGH | GPIO_PULL_DOWN)>
    , <&gpio0 29 (GPIO_ACTIVE_HIGH | GPIO_PULL_DOWN)>
    , <&gpio0 02 (GPIO_ACTIVE_HIGH | GPIO_PULL_DOWN)>
    ;

  col-gpios
    = <&gpio1 15 GPIO_ACTIVE_HIGH>
    , <&gpio1 06 GPIO_ACTIVE_HIGH>
    , <&gpio1 04 GPIO_ACTIVE_HIGH>
    , <&gpio0 11 GPIO_ACTIVE_HIGH>
    , <&gpio1 00 GPIO_ACTIVE_HIGH>
    , <&gpio0 20 GPIO_ACTIVE_HIGH>
    , <&gpio0 17 GPIO_ACTIVE_HIGH>
    ;
};

&default_transform {
  col-offset = <7>;
};
